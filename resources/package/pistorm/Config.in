## resources/package/pistorm/Config.in
```kconfig
config BR2_PACKAGE_PISTORM
        bool "pistorm"
        select BR2_PACKAGE_SDL2
        help
          A 68000 CPU replacement.

          https://github.com/captain-amygdala/pistorm
```
